## main/Kconfig.projbuild
```kconfig
menu "Example Configuration"

   config WIFI_SSID
       string "WiFi SSID"
       default "myssid"

   config WIFI_PASSWORD
       string "WiFi Password"
       default "mypassword"

   config SETUP_AP_SSID
       string "Setup access point SSID"
       default "Climatronic-Setup"

   config SETUP_AP_PASSWORD
       string "Setup access point password (at least 8 characters)"
       default "clima-setup"

endmenu
```
