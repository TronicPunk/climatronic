## main/Kconfig.projbuild
```kconfig
menu "Example Configuration"

   config WIFI_SSID
       string "WiFi SSID"
       default "myssid"

   config WIFI_PASSWORD
       string "WiFi Password"
       default "mypassword"

   config SETUP_AP_SSID
       string "Setup access point SSID"
       default "Climatronic-Setup"

   config SETUP_AP_PASSWORD
       string "Setup access point password (at least 8 characters)"
       default "clima-setup"

endmenu

menu "Climatronic MQTT"

   config CLIMATRONIC_MQTT_BROKER_URI
       string "MQTT broker URI"
       default ""
       help
           For example mqtt://broker.example:1883 or mqtts://broker.example:8883.
           Leave empty to disable MQTT. TLS uses the ESP certificate bundle.

   config CLIMATRONIC_MQTT_USERNAME
       string "MQTT username"
       default ""

   config CLIMATRONIC_MQTT_PASSWORD
       string "MQTT password"
       default ""

   config CLIMATRONIC_MQTT_TOPIC_PREFIX
       string "MQTT topic prefix"
       default "climatronic"

   config CLIMATRONIC_MQTT_PUBLISH_INTERVAL_MS
       int "MQTT publish interval (ms)"
       range 1000 3600000
       default 5000

endmenu
```
